## NAT reference/sdkconfig.defaults
```kconfig
# Flash Configuration - M5StickC Plus 2 has 8MB flash
CONFIG_ESPTOOLPY_FLASHSIZE_8MB=y
CONFIG_PARTITION_TABLE_SINGLE_APP=y

# LWIP Configuration - ENABLE NAT/NAPT
CONFIG_LWIP_IP_FORWARD=y
CONFIG_LWIP_IPV4_NAPT=y
CONFIG_LWIP_L2_TO_L3_COPY=y

# Explicitly enable NAPT (required for ip_napt_enable functions)
CONFIG_LWIP_IP_NAT=y

# NAT/NAPT table sizes (increase for more simultaneous connections)
CONFIG_LWIP_NAPT_MAX=512
CONFIG_LWIP_NAPT_PORTMAP_MAX=32
CONFIG_LWIP_NAPT_PORTMAP_TIMEOUT=600000

# Socket limits (increase for DNS proxy + HTTP server + clients)
CONFIG_LWIP_MAX_SOCKETS=16
CONFIG_LWIP_SO_REUSE=y
CONFIG_LWIP_SO_RCVBUF=y

# WiFi Configuration
CONFIG_ESP32_WIFI_STATIC_RX_BUFFER_NUM=10
CONFIG_ESP32_WIFI_DYNAMIC_RX_BUFFER_NUM=32
CONFIG_ESP32_WIFI_DYNAMIC_TX_BUFFER_NUM=32

# Increase main task stack size for web server
CONFIG_ESP_MAIN_TASK_STACK_SIZE=8192

# Enable console UART
CONFIG_ESP_CONSOLE_UART_DEFAULT=y
CONFIG_ESP_CONSOLE_UART_NUM=0
CONFIG_ESP_CONSOLE_UART_BAUDRATE=115200
```

## sdkconfig.defaults
```kconfig
# Flash Configuration - M5StickC Plus 2 has 8MB flash
CONFIG_ESPTOOLPY_FLASHSIZE_8MB=y
CONFIG_PARTITION_TABLE_SINGLE_APP=y

# LWIP Configuration - ENABLE NAT
CONFIG_LWIP_IP_FORWARD=y
CONFIG_LWIP_IPV4_NAPT=y
CONFIG_LWIP_L2_TO_L3_COPY=y

# NAT/NAPT table sizes (increase for more simultaneous connections)
CONFIG_LWIP_NAPT_PORTMAP_MAX=32
CONFIG_LWIP_NAPT_PORTMAP_TIMEOUT=600000

# WiFi Configuration
CONFIG_ESP32_WIFI_STATIC_RX_BUFFER_NUM=10
CONFIG_ESP32_WIFI_DYNAMIC_RX_BUFFER_NUM=32
CONFIG_ESP32_WIFI_DYNAMIC_TX_BUFFER_NUM=32

# Increase main task stack size for web server
CONFIG_ESP_MAIN_TASK_STACK_SIZE=8192

# Enable console UART
CONFIG_ESP_CONSOLE_UART_DEFAULT=y
CONFIG_ESP_CONSOLE_UART_NUM=0
CONFIG_ESP_CONSOLE_UART_BAUDRATE=115200
```
